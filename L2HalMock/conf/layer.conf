## L2HalMock/conf/layer.conf
```bitbake
BBPATH .= ":${LAYERDIR}"

BBFILES += "\\
            ${LAYERDIR}/recipes-*/*/*.bb \\
            ${LAYERDIR}/recipes-*/*/*/*.bb \\
            ${LAYERDIR}/recipes-*/*/*.bbappend \\
           "

BBFILE_COLLECTIONS += "l2halmock"
BBFILE_PATTERN_l2halmock := "^${LAYERDIR}/"
BBFILE_PRIORITY_l2halmock = "9"
LAYERSERIES_COMPAT_l2halmock = "zeus dunfell kirkstone"

# Minimal defaults for running meta-rdk-video outside the full RDK distro setup.
CMF_GIT_PROTOCOL ?= "https"
CMF_GITHUB_PROTOCOL ?= "${CMF_GIT_PROTOCOL}"
CMF_GIT_BRANCH ?= "main"
CMF_GIT_MASTER_BRANCH ?= "main"
CMF_GITHUB_MASTER_BRANCH ?= "main"
CMF_GITHUB_ROOT ?= "git://github.com/rdkcentral"
CMF_GITHUB_SRC_URI_SUFFIX ?= "protocol=${CMF_GITHUB_PROTOCOL};branch=${CMF_GITHUB_MASTER_BRANCH}"

# Recipes using CMF_GIT_ROOT are not part of the immediate L2HalMock dependency
# chain, but they still need syntactically valid fetch URLs during global parsing.
CMF_GIT_ROOT ?= "git://github.com/rdkcentral"

# Some meta-rdk-video recipes assume an RDKROOT exists for optional layer checks.
RDKROOT ?= "/workspace"

# Standalone defaults for recipes that derive artifact metadata from the larger
# RDK distro environment.
PROJECT_BRANCH ?= "main"
PLATFORM_PATH ?= "unknown"
LOG_BACKTRACE ?= "n"
BACKTRACE_LDFLAGS ?= ""

# Resolve VIRTUAL-RUNTIME variables with our L2HalMock stubs
VIRTUAL-RUNTIME_mfrlib ?= "mfrlib"
PREFERRED_PROVIDER_virtual/mfrlib ?= "mfrlib"

# Enable systemd DISTRO_FEATURE so iarmmgrs and others can depend on it
DISTRO_FEATURES:append = " systemd"

# Standalone L2HalMock builds currently target the HdmiCecSource stack only.
# Mask unrelated recipe families from meta-rdk-video that rely on the broader
# RDK distro environment and are not required for this dependency chain.
BBMASK += "|/meta-rdk-video/recipes-extended/aamp/"
BBMASK += "|/meta-rdk-video/recipes-extended/ctrlm/"
BBMASK += "|/meta-rdk-video/recipes-extended/cobalt/"
BBMASK += "|/meta-rdk-video/recipes-extended/subtec-app/"
BBMASK += "|/meta-rdk-video/recipes-extended/xr-voice-sdk/"
BBMASK += "|/meta-rdk-video/recipes-graphics/javascriptcore/"
BBMASK += "|/meta-rdk-video/recipes-extended/wpe-webkit/"
BBMASK += "|/meta-rdk-video/recipes-common/libunpriv/libunpriv\.bbappend$"
BBMASK += "|/meta-rdk-video/recipes-common/systimemgr/systimemgr_git\.bbappend$"
BBMASK += "|/meta-rdk-video/recipes-common/systimemgr/systimemgrfactory_git\.bbappend$"
BBMASK += "|/meta-rdk-video/recipes-common/telemetry/telemetry_git\.bbappend$"
BBMASK += "|/meta-rdk-video/recipes-core/packagegroups/packagegroup-rdk-media-common\.bbappend$"
BBMASK += "|/meta-rdk-video/recipes-core/packagegroups/packagegroup-rdk-oss-mediaclient\.bbappend$"
BBMASK += "|/meta-rdk-video/recipes-core/packagegroups/packagegroup-tdk\.bbappend$"
BBMASK += "|/meta-rdk-video/recipes-extended/rfc/rfc_git\.bbappend$"
BBMASK += "|/meta-rdk-video/recipes-extended/xupnp/xupnp_git\.bbappend$"
BBMASK += "|/meta-rdk-video/recipes-support/cpeabs/cpeabs_%\.bbappend$"
BBMASK += "|/meta-rdk-video/recipes-support/parodus/parodus_%\.bbappend$"
BBMASK += "|/meta-rdk-video/recipes-support/wdmp-c/wdmp-c_1\.0\.bbappend$"
BBMASK += "|/meta-rdk-video/recipes-support/webcfg/webcfg_%\.bbappend$"
```

## conf/distro/include/rdk_video_lto.inc
```bitbake
LTO:pn-netsrvmgr = ""
LTO:pn-tr69hostif = ""
LTO:pn-servicemanager = ""
LTO:pn-ledmgr = ""
LTO:pn-ledmgr-headers = ""
LTO:pn-wpeframework-clientlibraries = ""
LTO:pn-hwselftest = ""
LTO:pn-brotli = ""
```

## conf/layer.conf
```bitbake
BBPATH .= ":${LAYERDIR}"

BBFILES += "\
            ${LAYERDIR}/recipes-*/*/*.bb \
            ${LAYERDIR}/recipes-*/*/*/*.bb \
            ${LAYERDIR}/recipes-*/*/*.bbappend \
           "

BBFILE_COLLECTIONS += "video"
BBFILE_PATTERN_video := "^${LAYERDIR}/"
BBFILE_PRIORITY_video = "7"
LAYERSERIES_COMPAT_video = "zeus dunfell kirkstone"

# license directories.
LICENSE_PATH += "${LAYERDIR}/licenses"

require conf/distro/include/rdk_video_lto.inc
```

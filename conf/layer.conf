## conf/layer.conf
```bitbake
BBPATH .= ":${LAYERDIR}"

BBFILES += "\
            ${LAYERDIR}/recipes-*/*/*.bb \
            ${LAYERDIR}/recipes-*/*/*/*.bb \
            ${LAYERDIR}/recipes-*/*/*.bbappend \
           "

BBFILE_COLLECTIONS += "video"
BBFILE_PATTERN_video := "^${LAYERDIR}/"
BBFILE_PRIORITY_video = "7"
LAYERSERIES_COMPAT_video = "zeus dunfell kirkstone"

# license directories.
LICENSE_PATH += "${LAYERDIR}/licenses"

require conf/distro/include/rdk_video_lto.inc
BBMASK .= "|.meta-rdk-video/recipes-halif-aidl/rdk-halif-aidl-mw/rdk-halif-aidl-mw.bb"
```
